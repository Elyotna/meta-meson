## conf/machine/amlogic-p212.conf
```bitbake
# Amlogic P212 board

require conf/machine/include/amlogic-s905x.inc
require conf/machine/include/amlogic-p212-dtb.inc

EXTRA_IMAGEDEPENDS += "u-boot amlogic-fip-p212"

PREFERRED_PROVIDER_virtual/bootloader = "u-boot"
PREFERRED_PROVIDER_u-boot = "u-boot"
PREFERRED_VERSION_u-boot = "2018.01%"

UBOOT_MACHINE = "p212_defconfig"
```

## conf/machine/khadas-vim.conf
```bitbake
# Khadas VIM board

require conf/machine/include/amlogic-s905x.inc
require conf/machine/include/khadas-vim-dtb.inc

EXTRA_IMAGEDEPENDS += "u-boot amlogic-fip-khadas-vim"

PREFERRED_PROVIDER_virtual/bootloader = "u-boot"
PREFERRED_PROVIDER_u-boot = "u-boot"
PREFERRED_VERSION_u-boot = "2018.01%"

UBOOT_MACHINE = "khadas-vim_defconfig"
```

## conf/machine/libretech-cc.conf
```bitbake
# LibreTech CC board

require conf/machine/include/amlogic-s905x.inc
require conf/machine/include/libretech-cc-dtb.inc

PREFERRED_PROVIDER_virtual/bootloader = "u-boot"
PREFERRED_PROVIDER_u-boot = "u-boot"
PREFERRED_VERSION_u-boot = "v2018.01%"

UBOOT_MACHINE = "libretech-cc_defconfig"
```
